## configs/mt6739_agm_m7_defconfig
```kconfig
CONFIG_ARM=y
CONFIG_SKIP_LOWLEVEL_INIT=y
CONFIG_COUNTER_FREQUENCY=13000000
CONFIG_POSITION_INDEPENDENT=y
CONFIG_ARCH_MEDIATEK=y
CONFIG_TEXT_BASE=0x40200000
CONFIG_SYS_MALLOC_LEN=0x2000000
CONFIG_SYS_MALLOC_F_LEN=0x4000
CONFIG_NR_DRAM_BANKS=1
CONFIG_DEFAULT_DEVICE_TREE="mt6739-agm-m7"
CONFIG_TARGET_MT6739=y
CONFIG_SYS_LOAD_ADDR=0x48000000
CONFIG_SYS_BOOTM_LEN=0x4000000
# CONFIG_PSCI_RESET is not set
CONFIG_BOOTDELAY=0
CONFIG_USE_BOOTCOMMAND=y
CONFIG_BOOTCOMMAND="if test ${lk_bootmode} = 8 || test ${lk_bootmode} = 9; then run boot_nixos; fi; bootmenu 3; echo agm-m7: boot failed; sleep 5; reset"
CONFIG_SYS_PBSIZE=1024
CONFIG_HUSH_PARSER=y
CONFIG_CMD_BDI=y
CONFIG_CMD_FDT=y
CONFIG_ENV_IS_NOWHERE=y
CONFIG_DM_SERIAL=y
CONFIG_RAMCONSOLE_SERIAL=y
CONFIG_DEBUG_UART=y
CONFIG_DEBUG_UART_RAMCONSOLE=y
CONFIG_DEBUG_UART_BASE=0x4445f000
CONFIG_DEBUG_UART_CLOCK=0
CONFIG_DEBUG_UART_ANNOUNCE=y
CONFIG_CMD_SLEEP=y
CONFIG_WDT=y
CONFIG_WDT_MTK=y
CONFIG_WATCHDOG_TIMEOUT_MSECS=15000
CONFIG_CLK=y
CONFIG_MMC_MTK=y
CONFIG_CMD_MMC=y
CONFIG_CMD_PART=y
CONFIG_EFI_PARTITION=y
CONFIG_ANDROID_BOOT_IMAGE=y
CONFIG_VIDEO=y
CONFIG_VIDEO_MT6739_DBI=y
CONFIG_CONSOLE_MUX=y
CONFIG_SYS_CONSOLE_IS_IN_ENV=y
CONFIG_SYS_WHITE_ON_BLACK=y
# CONFIG_VIDEO_LOGO is not set
CONFIG_DM_KEYBOARD=y
CONFIG_MTK_KEYPAD=y
CONFIG_CMD_BOOTMENU=y
CONFIG_BOARD_LATE_INIT=y
CONFIG_OF_BOARD_SETUP=y
CONFIG_CMD_SYSBOOT=y
CONFIG_CMD_FAT=y
CONFIG_FS_FAT=y
CONFIG_CMD_FS_GENERIC=y
CONFIG_SUPPORT_RAW_INITRD=y
```
